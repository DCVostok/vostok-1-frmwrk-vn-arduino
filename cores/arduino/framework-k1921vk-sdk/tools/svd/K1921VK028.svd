# K1921VK028 register map
Vendor: NIIET; Series: K1921VKx; File version: 2.17
Motor control MCU
CPU: CM4 r0p1, little endian, MPU, FPU, 4 interrupt priority bits
Registers are 32-bit, read-write, reset 0x0 unless marked. A register's access mark holds for its fields unless they carry their own. Offsets are from the block's base; lines under a group give offsets from that group; [hi:lo] are bit positions; {n}, {i} and the like mark numbered series; 'fields as' and 'values as' point back to an identical list; <NAME> marks a mode.

## Memory map
0x40010000 GPIOA size 0xC04 — GPIO control registers
0x40011000 GPIOB size 0xC04
0x40012000 GPIOC size 0xC04
0x40013000 GPIOD size 0xC04
0x40014000 GPIOE size 0xC04
0x40015000 GPIOF size 0xC04
0x40016000 GPIOG size 0xC04
0x40017000 GPIOH size 0xC04
0x40018000 GPIOJ size 0xC04
0x40019000 GPIOK size 0xC04
0x4001A000 GPIOL size 0xC04
0x4001B000 GPIOM size 0xC04
0x40020000 CAN size 0x3004 — CAN controller registers
0x40021000 CANMSG size 0x2004 — CAN Msg registers
0x40030000 ETH size 0x1A0 — ETHERNET controller registers
0x40040000 TMU size 0x20 — TMU controller registers
0x40060000 MFLASH size 0x78 — Mainflash control registers
0x40061000 BFLASH size 0x78 — Bootflash control registers
0x40062000 EXTMEM size 0x24 — External memory control registers
0x40070000 SPWR0 size 0x34 — SpaceWire control registers
0x40071000 SPWR1 size 0x34
0x40072000 MILSTD0 size 0xE4 — MIL-STD 1553 control registers
0x40073000 MILSTD1 size 0xE4
0x40074000 SPWRTMR size 0xC — SpaceWire timer controller registers
0x40075000 SDFM size 0xDC — SDFM controller registers
0x40080000 SIU size 0x1000 — System integration unit registers
0x40081000 RCU size 0x108 — Reset and clock unit registers
0x40082000 PMU size 0x14 — Power management unit registers
0x40083000 WDT size 0xC04 — Watchdog control registers
0x40084000 DMA size 0x50 — DMA control registers
0x40085000 UART0 size 0x4C — UART control registers
0x40086000 UART1 size 0x4C
0x40087000 UART2 size 0x4C
0x40088000 UART3 size 0x4C
0x40089000 TUART0 size 0x14 — Tiny UART control registers
0x4008A000 TUART1 size 0x14
0x4008B000 I2C0 size 0x28 — I2C controller registers
0x4008C000 I2C1 size 0x28
0x4008D000 SPI0 size 0x28 — SPI control registers
0x4008E000 SPI1 size 0x28
0x4008F000 SPI2 size 0x28
0x40090000 SPI3 size 0x28
0x40091000 TMR0 size 0x18 — TMR controller registers
0x40092000 TMR1 size 0x18
0x40093000 TMR2 size 0x18
0x40094000 TMR3 size 0x18
0x40095000 ETMR0 size 0x20 — ETMR controller registers
0x40096000 ETMR1 size 0x20
0x40097000 ETMR2 size 0x20
0x40098000 ETMR3 size 0x20
0x40099000 RTC size 0x50 — RTC controller registers
0x4009A000 ECAP0 size 0x44 — ECAP controller registers
0x4009B000 ECAP1 size 0x44
0x4009C000 ECAP2 size 0x44
0x4009D000 ECAP3 size 0x44
0x4009E000 ECAP4 size 0x44
0x4009F000 ECAP5 size 0x44
0x400A0000 PWM0 size 0xAC — PWM controller registers
{0x400A0000+0x1000*n} PWM{n} size 0xAC (n=1..9)
0x400AA000 QEP0 size 0x74 — QEP controller registers
0x400AB000 QEP1 size 0x74
0x400AC000 QEP2 size 0x74
0x400AD000 QEP3 size 0x74
0x400AE000 LAU size 0x3E4 — LAU controller registers
0x400AF000 OWI0 size 0x18 — OWI control registers
0x400B0000 OWI1 size 0x18
0x400B1000 ADC size 0x644 — ADC control registers

## Interrupts
0 WDT — Watchdog timer interrupt
1 RCU — Reset and clock unit interrupt
2 RTC — RTC interrupt
3 MFLASH — MFLASH interrupt
4 BFLASH — BFLASH interrupt
5 GPIOA — GPIO A interrupt
6 GPIOB — GPIO B interrupt
7 GPIOC — GPIO C interrupt
8 GPIOD — GPIO D interrupt
9 GPIOE — GPIO E interrupt
10 GPIOF — GPIO F interrupt
11 GPIOG — GPIO G interrupt
12 GPIOH — GPIO H interrupt
13 GPIOJ — GPIO J interrupt
14 GPIOK — GPIO K interrupt
15 GPIOL — GPIO L interrupt
16 GPIOM — GPIO M interrupt
{n+17} DMA_CH{n} (DMA) (n=0..31) — DMA channel {n} interrupt
49 TMR0 — Timer 0 interrupt
50 TMR1 — Timer 1 interrupt
51 TMR2 — Timer 2 interrupt
52 TMR3 — Timer 3 interrupt
53 ETMR0 — Enhanced Timer 0 interrupt
54 ETMR1 — Enhanced Timer 1 interrupt
55 ETMR2 — Enhanced Timer 2 interrupt
56 ETMR3 — Enhanced Timer 3 interrupt
57 UART0_TD (UART0) — UART0 Transmit Done interrupt
58 UART0_MS (UART0) — UART0 Modem interrupt
59 UART0_RX (UART0) — UART0 Recieve interrupt
60 UART0_TX (UART0) — UART0 Transmit interrupt
61 UART0_RT (UART0) — UART0 Recieve interrupt
62 UART0_E (UART0) — UART0 Error interrupt
63 UART0 — UART0 interrupt
64 UART1_TD (UART1) — UART1 Transmit Done interrupt
65 UART1_MS (UART1) — UART1 Modem interrupt
66 UART1_RX (UART1) — UART1 Recieve interrupt
67 UART1_TX (UART1) — UART1 Transmit interrupt
68 UART1_RT (UART1) — UART1 Recieve interrupt
69 UART1_E (UART1) — UART1 Error interrupt
70 UART1 — UART1 interrupt
71 UART2_TD (UART2) — UART2 Transmit Done interrupt
72 UART2_MS (UART2) — UART2 Modem interrupt
73 UART2_RX (UART2) — UART2 Recieve interrupt
74 UART2_TX (UART2) — UART2 Transmit interrupt
75 UART2_RT (UART2) — UART2 Recieve interrupt
76 UART2_E (UART2) — UART2 Error interrupt
77 UART2 — UART2 interrupt
78 UART3_TD (UART3) — UART3 Transmit Done interrupt
79 UART3_MS (UART3) — UART3 Modem interrupt
80 UART3_RX (UART3) — UART3 Recieve interrupt
81 UART3_TX (UART3) — UART3 Transmit interrupt
82 UART3_RT (UART3) — UART3 Recieve interrupt
83 UART3_E (UART3) — UART3 Error interrupt
84 UART3 — UART3 interrupt
85 TUART0_RX (TUART0) — Tiny UART0 Receive interrupt
86 TUART0_TX (TUART0) — Tiny UART0 Transmit interrupt
87 TUART0_RO (TUART0) — Tiny UART0 Receive Overrun interrupt
88 TUART0_TO (TUART0) — Tiny UART0 Transmit Overrun interrupt
89 TUART0 — Tiny UART0 interrupt
90 TUART1_RX (TUART1) — Tiny UART1 Receive interrupt
91 TUART1_TX (TUART1) — Tiny UART1 Transmit interrupt
92 TUART1_RO (TUART1) — Tiny UART1 Receive Overrun interrupt
93 TUART1_TO (TUART1) — Tiny UART1 Transmit Overrun interrupt
94 TUART1 — Tiny UART1 interrupt
95 SPI0 — SPI0 interrupt
96 SPI0_RX (SPI0) — SPI0 Receive interrupt
97 SPI0_TX (SPI0) — SPI0 Transmit interrupt
98 SPI0_RO (SPI0) — SPI0 Receive Overrun interrupt
99 SPI0_RT (SPI0) — SPI0 Receive Timeout interrupt
100 SPI1 — SPI1 interrupt
101 SPI1_RX (SPI1) — SPI1 Receive interrupt
102 SPI1_TX (SPI1) — SPI1 Transmit interrupt
103 SPI1_RO (SPI1) — SPI1 Receive Overrun interrupt
104 SPI1_RT (SPI1) — SPI1 Receive Timeout interrupt
105 SPI2 — SPI2 interrupt
106 SPI2_RX (SPI2) — SPI2 Receive interrupt
107 SPI2_TX (SPI2) — SPI2 Transmit interrupt
108 SPI2_RO (SPI2) — SPI2 Receive Overrun interrupt
109 SPI2_RT (SPI2) — SPI2 Receive Timeout interrupt
110 SPI3 — SPI3 interrupt
111 SPI3_RX (SPI3) — SPI3 Receive interrupt
112 SPI3_TX (SPI3) — SPI3 Transmit interrupt
113 SPI3_RO (SPI3) — SPI3 Receive Overrun interrupt
114 SPI3_RT (SPI3) — SPI3 Receive Timeout interrupt
115 I2C0 — I2C0 interrupt
116 I2C1 — I2C1 interrupt
117 SPWR0 — SpaceWire0 interrupt
118 SPWR1 — SpaceWire1 interrupt
119 MILSTD0 — MIL-STD 1553 0 interrupt
120 MILSTD1 — MIL-STD 1553 1 interrupt
121 ECAP0 — Capture Unit 0 interrupt
122 ECAP1 — Capture Unit 1 interrupt
123 ECAP2 — Capture Unit 2 interrupt
124 ECAP3 — Capture Unit 3 interrupt
125 ECAP4 — Capture Unit 4 interrupt
126 ECAP5 — Capture Unit 5 interrupt
{3n+127} PWM{n} (n=0..9) — PWM{n} interrupt
{3n+128} PWM{n}_HD (PWM{n}) (n=0..9) — PWM{n} HD interrupt
{3n+129} PWM{n}_TZ (PWM{n}) (n=0..9) — PWM{n} TZ interrupt
157 QEP0 — QEP0 interrupt
158 QEP1 — QEP1 interrupt
159 QEP2 — QEP2 interrupt
160 QEP3 — QEP3 interrupt
{n+161} ADC_SEQ{n} (ADC) (n=0..7) — ADC Sequencer {n} interrupt
169 ADC_DC (ADC) — ADC Digital Comparator interrupt
170 ETH — Ethernet interrupt
{n+171} CAN{n} (CAN) (n=0..15) — CAN{n} interrupt
187 FPU (SIU) — FPU exception interrupt
188 TMU — TMU interrupt
189 LAU — LAU interrupt
190 SDFM — SDFM interrupt
191 OWI0 — OWI0 interrupt
192 OWI1 — OWI1 interrupt

## Licence text in the file
ARM Limited (ARM) is supplying this software for use with Cortex-M processor based microcontroller, but can be equally used for other suitable processor architectures. This file can be freely distributed. Modifications to this file shall be clearly marked. . THIS SOFTWARE IS PROVIDED "AS IS". NO WARRANTIES, WHETHER EXPRESS, IMPLIED. OR STATUTORY, INCLUDING, BUT NOT LIMITED TO, IMPLIED WARRANTIES OF. MERCHANTABILITY AND FITNESS FOR A PARTICULAR PURPOSE APPLY TO THIS SOFTWARE. ARM SHALL NOT, IN ANY CIRCUMSTANCES, BE LIABLE FOR SPECIAL, INCIDENTAL, OR. CONSEQUENTIAL DAMAGES, FOR ANY REASON WHATSOEVER.
